## telemetria_y_comunicacion_esp_1/build/primary/Kconfig/arch/Kconfig
```kconfig
# Load Zephyr Arch Kconfig descriptions.
osource "C:/zephyr/zephyresp32/deps/zephyr/arch/rx/Kconfig"
osource "C:/zephyr/zephyresp32/deps/zephyr/arch/x86/Kconfig"
osource "C:/zephyr/zephyresp32/deps/zephyr/arch/xtensa/Kconfig"
osource "C:/zephyr/zephyresp32/deps/zephyr/arch/sparc/Kconfig"
osource "C:/zephyr/zephyresp32/deps/zephyr/arch/riscv/Kconfig"
osource "C:/zephyr/zephyresp32/deps/zephyr/arch/posix/Kconfig"
osource "C:/zephyr/zephyresp32/deps/zephyr/arch/openrisc/Kconfig"
osource "C:/zephyr/zephyresp32/deps/zephyr/arch/mips/Kconfig"
osource "C:/zephyr/zephyresp32/deps/zephyr/arch/arm64/Kconfig"
osource "C:/zephyr/zephyresp32/deps/zephyr/arch/arm/Kconfig"
osource "C:/zephyr/zephyresp32/deps/zephyr/arch/arc/Kconfig"
```

## telemetria_y_comunicacion_esp_1/build/primary/Kconfig/boards/Kconfig
```kconfig
# Load Zephyr board Kconfig descriptions.
osource "C:/zephyr/zephyresp32/deps/zephyr/boards/espressif/esp32_devkitc/Kconfig"
```

## telemetria_y_comunicacion_esp_1/build/primary/Kconfig/boards/Kconfig.defconfig.tmp
```kconfig
# Load Zephyr board defconfig descriptions.
osource "C:/zephyr/zephyresp32/deps/zephyr/boards/espressif/esp32_devkitc/Kconfig.defconfig"
```

## telemetria_y_comunicacion_esp_1/build/primary/Kconfig/boards/Kconfig.esp32_devkitc
```kconfig
# Load board Kconfig descriptions.
osource "C:/zephyr/zephyresp32/deps/zephyr/boards/espressif/esp32_devkitc/Kconfig.esp32_devkitc"
```
